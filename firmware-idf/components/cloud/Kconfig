## firmware-idf/components/cloud/Kconfig
```kconfig
menu "Cloud (AWS IoT)"

    config CLOUD_TOPIC_PREFIX
        string "MQTT topic prefix"
        default "siedle"
        help
            <prefix>/received, <prefix>/sent and <prefix>/send are shared with the Lambda functions.

    config CLOUD_STATUS_INTERVAL_SEC
        int "Publish the device status every (seconds)"
        range 10 3600
        default 60

endmenu
```

## firmware-idf/components/ota/Kconfig
```kconfig
menu "OTA updates"

    config OTA_CONFIRM_TIMEOUT_SEC
        int "Roll back an unconfirmed new firmware after (seconds)"
        range 60 3600
        default 600
        help
            A freshly installed firmware confirms itself once it reached the cloud. If that does not happen in
            time, the device reboots into the previous firmware.

endmenu
```

## firmware-idf/components/siedle_log/Kconfig
```kconfig
menu "Siedle event log"

    config SIEDLE_LOG_SIZE
        int "Number of bus events kept in RAM"
        range 4 256
        default 32
        help
            The most recent bus events are shown in the web UI.

endmenu
```

## firmware-idf/components/web_ui/Kconfig
```kconfig
menu "Web UI"

    config WEB_UI_SETTINGS_FROM_NETWORK
        bool "Allow changing the cloud and gateway settings from the network (development only)"
        default n
        depends on !SECURE_BOOT && !SECURE_FLASH_ENC_ENABLED
        help
            Makes the cloud and gateway settings of the setup page (AWS IoT endpoint, thing name, certificate,
            device key, hostname, hotspot password) available from the regular network, without the setup
            button and the setup hotspot. Handy on a development board to swap certificates, sdkconfig.dev
            turns it on.

            Never install such a build: anyone on the gateway's network could point it at their own AWS IoT
            account and send it commands, including the one that opens the door. Release builds leave it off,
            and it is not available together with secure boot or flash encryption.

endmenu
```

## firmware-idf/components/wifi_mgr/Kconfig
```kconfig
menu "Wi-Fi manager"

    config WIFI_MGR_AP_SSID_PREFIX
        string "Setup hotspot SSID prefix"
        default "Siedle-Setup"
        help
            The last two bytes of the MAC address are appended, e.g. "Siedle-Setup-A1B2".

    config WIFI_MGR_AP_CHANNEL
        int "Setup hotspot channel"
        range 1 13
        default 1
        help
            While the station is connected the hotspot follows the station's channel.

    config WIFI_MGR_PORTAL_FALLBACK_SEC
        int "Open the setup hotspot after being offline for (seconds)"
        default 300
        help
            The station keeps retrying in the background while the hotspot is open.

    config WIFI_MGR_PORTAL_LINGER_SEC
        int "Keep the setup hotspot open after connecting (seconds)"
        default 60
        help
            Gives the setup page time to show the new address before the hotspot disappears.

    config WIFI_MGR_PORTAL_IDLE_SEC
        int "Close a hotspot opened on request after being unused for (seconds)"
        default 600
        help
            Applies to the hotspot opened with the setup button. While the station is offline, it stays open like
            the automatic one.

endmenu
```

## firmware-idf/main/Kconfig.projbuild
```kconfig
menu "Siedle Gateway"

    config GATEWAY_HOSTNAME
        string "Hostname"
        default "siedle"
        help
            DHCP and mDNS name, the web UI is reachable at http://<hostname>.local/.
            Can be overridden per device with the "hostname" key in devcfg.

    config GATEWAY_NTP_SERVER
        string "NTP server"
        default "de.pool.ntp.org"

    config GATEWAY_SETUP_BUTTON_GPIO
        int "Setup button GPIO (-1 to disable)"
        range -1 48
        default 0
        help
            Active low, the internal pull-up is enabled. GPIO0 is the BOOT button on ESP32 and ESP32-S3 dev boards.

    config GATEWAY_SETUP_BUTTON_HOTSPOT_SEC
        int "Hold the setup button to open the setup hotspot (seconds)"
        range 1 30
        default 3
        help
            Releasing the button after holding it this long opens the setup hotspot. The Wi-Fi network stays
            configured, and the hotspot closes again once it is no longer used.

    config GATEWAY_SETUP_BUTTON_RESET_SEC
        int "Hold the setup button to forget the Wi-Fi network (seconds)"
        range 2 60
        default 10
        help
            Holding the button this long forgets the Wi-Fi credentials and opens the setup hotspot. Must be longer
            than the hotspot hold time.

endmenu
```
